## FunKey/Config.in
```kconfig
source "$BR2_EXTERNAL_FUNKEY_PATH/package/dmtx-utils/Config.in"
source "$BR2_EXTERNAL_FUNKEY_PATH/package/fonts-droid/Config.in"
source "$BR2_EXTERNAL_FUNKEY_PATH/package/libini/Config.in"
source "$BR2_EXTERNAL_FUNKEY_PATH/package/libopk/Config.in"
source "$BR2_EXTERNAL_FUNKEY_PATH/package/libxdgmime/Config.in"
source "$BR2_EXTERNAL_FUNKEY_PATH/package/gmenu2x/Config.in"
source "$BR2_EXTERNAL_FUNKEY_PATH/package/agg/Config.in"
source "$BR2_EXTERNAL_FUNKEY_PATH/package/fluidlite/Config.in"
source "$BR2_EXTERNAL_FUNKEY_PATH/package/libmikmod/Config.in"
```

## configs/pangolin_defconfig
```kconfig
CONFIG_SUNXI_PANGOLIN=y
CONFIG_SPL=y
CONFIG_SYS_EXTRA_OPTIONS="USB_EHCI,SUNXI_GMAC,RGMII"
CONFIG_DEFAULT_DEVICE_TREE="sun6i-a31-pangolin"
CONFIG_VIDEO_VGA_VIA_LCD=y
CONFIG_VIDEO_VGA_EXTERNAL_DAC_EN="PH25"
CONFIG_ARM=y
CONFIG_ARCH_SUNXI=y
CONFIG_MACH_SUN6I=y
CONFIG_DRAM_CHANNELS=1
CONFIG_DRAM_CLK=360
CONFIG_DRAM_ZQ=70
CONFIG_AXP_DCDC1_VOLT=3300
CONFIG_AXP_ALDO1_VOLT=0
CONFIG_AXP_ALDO2_VOLT=1800
CONFIG_AXP_ALDO3_VOLT=3000
CONFIG_AXP_DLDO4_VOLT=3300
CONFIG_AXP_ELDO1_VOLT=1200
CONFIG_AXP_ELDO2_VOLT=2500
CONFIG_AXP_ELDO3_VOLT=3300
CONFIG_MMC_SUNXI_SLOT_EXTRA=2
CONFIG_CONS_INDEX=3
# Vbus gpio for usb1
CONFIG_USB1_VBUS_PIN=""
# No Vbus gpio for usb2
CONFIG_USB2_VBUS_PIN=""
CONFIG_USB=y
CONFIG_DM_USB=y
CONFIG_USB_EHCI=y
CONFIG_USB_KEYBOARD=y
CONFIG_DM_ETH=y
CONFIG_CMD_IMLS=n
CONFIG_ETH_DESIGNWARE=y
CONFIG_DM_SPI=y
CONFIG_DM_SPI_FLASH=y
CONFIG_SUNXI_SPI=y
```
